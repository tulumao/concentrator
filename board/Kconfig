## board/Kconfig
```kconfig
menu "Hardware Drivers Config"

config SOC_HC32F460PE
    bool 
    select SOC_SERIES_HC32F4
    select RT_USING_COMPONENTS_INIT
    select RT_USING_USER_MAIN
    default y

menu "Onboard Peripheral Drivers"

	config BSP_USING_SPI_FLASH
        bool "Enable spi flash"
        select RT_USING_SPI
		default n
		
	config BSP_USING_CURRENT_SENSOR
        bool "Enable Current Sensor"
        select RT_USING_SENSOR
		default n
		
	config BSP_USING_EXTERN_RTC
        bool "Enable Extern RTC(INS5699S)"
        select RT_USING_RTC
		default n
	
	menuconfig	BSP_USING_EXTERN_ETH
	        bool "Enable Ethernet(CH395Q)"
	        default n
	        select RT_USING_SPI
	        select RT_USING_GPIO
	        if BSP_USING_EXTERN_ETH
				config WCH_SPI_DEVICE
	         		string "SPI device name"
	         		default "spi30"
	         		
	         	config WCH_IRQ_PIN
	         		int "IRQ pin number"
	         		default 28
			
	         	config WCH_RST_PIN
	         		int "Reset pin number"
	         		default 29
	         			
				config WCH_PWR_PIN
	         		int "Power pin number"
	         		default 30
	         		
	         	config WCH_USING_DHCP
	         		bool "Enable alloc IP addresss through DHCP"
        			default y
	         		
	         	config WCH_USING_PING
	         		bool "Enable ping function"
        			default y
			endif
			
	menuconfig	BSP_USING_EXTERN_WIRELESS_ETH
	        bool "Enable wireless Ethernet"
	        default y
	        
	        if BSP_USING_EXTERN_WIRELESS_ETH
		    	menuconfig AT_DEVICE_USING_M590
		        	select RT_USING_UART
	        		select RT_USING_GPIO
		        	bool "Enable wireless Ethernet(M590)"
		        	default y
			        if AT_DEVICE_USING_M590
						config AT_DEVICE_M590_INIT_ASYN
			         		bool "Enable initialize by thread"
			         		default y
					
			         	config AT_DEVICE_M590_SOCKET
			         		bool "Enable M590 at socket"
			         		default y
			         		
			         	menuconfig AT_DEVICE_M590_SAMPLE
							bool "Enable sample"
			         		default y
			         		if AT_DEVICE_M590_SAMPLE
								config M590_SAMPLE_POWER_PIN
									int "Power pin"
									default 5
								
								config M590_SAMPLE_STATUS_PIN
									int "Power Status pin"
									default -1
								
								config M590_SAMPLE_WAKEUP_PIN
									int "Wakeup pin"
									default -1
									
								config M590_SAMPLE_CLIENT_NAME
									string "AT client device name"
									default "uart2"
							
								config M590_SAMPLE_RECV_BUFF_LEN
									int "The maximum length of receive line buffer"
									default 512
							endif
					endif
			endif
endmenu

menu "On-chip Peripheral Drivers"
    config BSP_USING_GPIO
        bool "Enable GPIO"
        select RT_USING_PIN
        default y

    menuconfig BSP_USING_UART
        bool "Enable UART"
        default y
        select RT_USING_SERIAL
        if BSP_USING_UART
            config BSP_USING_UART1
                bool "Enable UART1"
                default y

            config BSP_UART1_RX_USING_DMA
                bool "Enable UART1 RX DMA"
                depends on BSP_USING_UART1 && RT_SERIAL_USING_DMA
                default n

            config BSP_UART1_TX_USING_DMA
                bool "Enable UART1 TX DMA"
                depends on BSP_USING_UART1 && RT_SERIAL_USING_DMA
                default n

            config BSP_USING_UART2
                bool "Enable UART2"
                default n

            config BSP_UART2_RX_USING_DMA
                bool "Enable UART2 RX DMA"
                depends on BSP_USING_UART2 && RT_SERIAL_USING_DMA
                default n

            config BSP_UART2_TX_USING_DMA
                bool "Enable UART2 TX DMA"
                depends on BSP_USING_UART2 && RT_SERIAL_USING_DMA
                default n
            
            config BSP_USING_UART3
                bool "Enable UART3"
                default n

            config BSP_UART3_RX_USING_DMA
                bool "Enable UART3 RX DMA"
                depends on BSP_USING_UART3 && RT_SERIAL_USING_DMA
                default n

            config BSP_UART3_TX_USING_DMA
                bool "Enable UART3 TX DMA"
                depends on BSP_USING_UART3 && RT_SERIAL_USING_DMA
                default n

            config BSP_USING_UART4
                bool "Enable UART4"
                default n
            
            config BSP_UART4_RX_USING_DMA
                bool "Enable UART4 RX DMA"
                depends on BSP_USING_UART4 && RT_SERIAL_USING_DMA
                default n

            config BSP_UART4_TX_USING_DMA
                bool "Enable UART4 TX DMA"
                depends on BSP_USING_UART4 && RT_SERIAL_USING_DMA
                default n
        endif
		
	menuconfig BSP_USING_CAN
        bool "Enable CAN"
        default n
        select RT_USING_CAN
        if BSP_USING_CAN
            config BSP_USING_CAN1
                bool "using can1"
                default n
        endif
		
	menuconfig BSP_USING_ADC
        bool "Enable ADC"
        default n
        select RT_USING_ADC
        if BSP_USING_ADC
            config BSP_USING_ADC1
                bool "using adc1"
                default n
            config BSP_USING_ADC2
                bool "using adc2"
                default n
        endif

    menuconfig BSP_USING_RTC
        bool "Enable RTC"
        select RT_USING_RTC
        default n
        if BSP_USING_RTC
            choice
                prompt "Select clock source"
                default BSP_RTC_USING_LRC

                config BSP_RTC_USING_XTAL32
                    bool "RTC USING XTAL32"

                config BSP_RTC_USING_LRC
                    bool "RTC USING LRC"
            endchoice
        endif
	
	menuconfig BSP_USING_I2C
        bool "Enable I2C BUS"
        default n
        select RT_USING_I2C
        if BSP_USING_I2C
            config BSP_USING_I2C1
                bool "Enable i2c1 bus"
                default n

            config BSP_USING_I2C2
                bool "Enable i2c2 bus"
                default n
				
			config BSP_USING_I2C3
                bool "Enable i2c3 bus"
                default n
			
			config BSP_USING_I2C4
                bool "Enable i2c4 bus"
                default n
			
			config BSP_USING_I2C5
                bool "Enable i2c5 bus"
                default n
			
			config BSP_USING_I2C6
                bool "Enable i2c6 bus"
                default n
        endif
	
	config BSP_USING_WDT
        bool "Enable Watchdog Timer"
        select RT_USING_WDT
        default n

    menuconfig BSP_USING_PWM_TMRA
        bool "Enable timerA output PWM"
        depends on (!BSP_USING_UART3)
        default n
        select RT_USING_PWM
        if BSP_USING_PWM_TMRA
        menuconfig BSP_USING_PWM_TMRA_4
            bool "Enable timerA-4 output PWM"
            default n
            if BSP_USING_PWM_TMRA_4
                config BSP_USING_PWM_TMRA_4_CH7
                    bool "Enable timerA-4 channel7"
                    default n
                config BSP_USING_PWM_TMRA_4_CH8
                    bool "Enable timerA-4 channel8"
                    default n
            endif
        endif
		
	menuconfig BSP_USING_SPI
        bool "Enable SPI"
        default n
        select RT_USING_SPI
        if BSP_USING_SPI
            config BSP_USING_SPI1
                bool "Enable SPI1"
                default n
				
			config BSP_SPI1_RX_USING_DMA
                bool "Enable SPI1 RX DMA"
                depends on BSP_USING_SPI1
                default n

            config BSP_SPI1_TX_USING_DMA
                bool "Enable SPI1 TX DMA"
                depends on BSP_USING_SPI1
                default n
				
				
			config BSP_USING_SPI2
                bool "Enable SPI2"
                default n	

			config BSP_SPI2_RX_USING_DMA
                bool "Enable SPI2 RX DMA"
                depends on BSP_USING_SPI2
                default n

            config BSP_SPI2_TX_USING_DMA
                bool "Enable SPI2 TX DMA"
                depends on BSP_USING_SPI2
                default n

			config BSP_USING_SPI3
                bool "Enable SPI3"
                default n
			
			config BSP_SPI3_RX_USING_DMA
                bool "Enable SPI3 RX DMA"
                depends on BSP_USING_SPI3
                default n

            config BSP_SPI3_TX_USING_DMA
                bool "Enable SPI3 TX DMA"
                depends on BSP_USING_SPI3
                default n
			
			config BSP_USING_SPI4
                bool "Enable SPI4"
                default n
			
			config BSP_SPI4_RX_USING_DMA
                bool "Enable SPI4 RX DMA"
                depends on BSP_USING_SPI4
                default n

            config BSP_SPI4_TX_USING_DMA
                bool "Enable SPI4 TX DMA"
                depends on BSP_USING_SPI4
                default n
        endif
		
	menuconfig BSP_USING_QSPI
        bool "Enable QSPI"
        default n
        select RT_USING_SPI
        if BSP_USING_QSPI
			config BSP_QSPI_RX_USING_DMA
                bool "Enable QSPI RX DMA"
                depends on BSP_USING_QSPI
                default n

            config BSP_QSPI_TX_USING_DMA
                bool "Enable QSPI TX DMA"
                depends on BSP_USING_QSPI
                default n
				
        endif
	
	config BSP_USING_OTS
        bool "Enable Temperature Sensor"
        select RT_USING_SENSOR
		default n
		
	config BSP_USING_USB_FS
        bool "Enable OTGFS as USB Device"
		default n
		
		
	menuconfig BSP_USING_CPM
        bool "Enable Encryption Processing Module"
        default n
        select RT_USING_HWCRYPTO
        if BSP_USING_CPM
			config BSP_USING_RNG
        	bool "Enable TRNG"
        	select RT_HWCRYPTO_USING_RNG
			default n
		
			config BSP_USING_CRC
		        bool "Enable CRC"
		        select RT_HWCRYPTO_USING_CRC
				default n
				
			config BSP_USING_AES
		        bool "Enable AES"
		        select RT_HWCRYPTO_USING_AES
				default n
				
			config BSP_USING_SHA2
		        bool "Enable SHA2"
		        select RT_HWCRYPTO_USING_SHA2
		        select RT_HWCRYPTO_USING_SHA2_256
				default n
						
	endif
	
	config BSP_USING_LVD
        bool "Enable LVD"
		default n
        
	
endmenu


menu "Board extended module Drivers"
	
endmenu
 
endmenu
```
